#include <dt-bindings/zmk/matrix_transform.h>

/ {
	chosen {
		zmk,kscan = &kscan0;
		zmk,matrix_transform = &default_transform;
	};
		
	default_transform: keymap_transform_0 {
		compatible = "zmk,matrix-transform";
		columns = <2>;
		rows = <1>;
		map = <
RC(0,0) RC(0,1)
		>;
	};

	kscan0: kscan {
		compatible="zmk,kscan-gpio-direct";
		label = "KSCAN";
		input-gpios
		= <&pro_micro_d 7 (GPIO_ACTIVE_LOW | GPIO_PULL_UP)>
		, <&pro_micro_d 4 (GPIO_ACTIVE_LOW | GPIO_PULL_UP)>
		;
	};
};
