/*
 * Copyright (c) 2020 Michael van Eerd
 *
 * SPDX-License-Identifier: MIT
 */

#include <behaviors.dtsi>
#include <dt-bindings/zmk/keys.h>
#include <dt-bindings/zmk/bt.h>

/ {

    keymap {
        compatible = "zmk,keymap";

        default_layer {
            bindings = <
                &kp E 
            >;
	};
    };
};
