## config/boards/shields/staples_easy/Kconfig.defconfig
```kconfig
if SHIELD_STAPLES_EASY

config ZMK_KEYBOARD_NAME
    default "Easy button"

endif
```

## config/boards/shields/tightyl/Kconfig.defconfig
```kconfig
if SHIELD_TIGHTYL_LEFT

config ZMK_KEYBOARD_NAME
	default "Tightyl Left"

config ZMK_SPLIT_BLE_ROLE_CENTRAL
	default y

endif

if SHIELD_TIGHTYL_LEFT || SHIELD_TIGHTYL_RIGHT

config ZMK_SPLIT
	default y

endif
```

## config/boards/shields/tightyl/Kconfig.shield
```kconfig
config SHIELD_TIGHTYL_LEFT
	def_bool $(shields_list_contains,tightyl_left)

config SHIELD_TIGHTYL_RIGHT
	def_bool $(shields_list_contains,tightyl_right)
```

## config/boards/shields/tuck-n-roll/Kconfig.defconfig
```kconfig
if SHIELD_TUCK-N-ROLL_LEFT

config ZMK_KEYBOARD_NAME
	default "Tuck-n-roll"

config ZMK_SPLIT_BLE_ROLE_CENTRAL
	default y

endif

if SHIELD_TUCK-N-ROLL_LEFT || SHIELD_TUCK-N-ROLL_RIGHT

config ZMK_SPLIT
	default y

endif
```

## config/boards/shields/tuck-n-roll/Kconfig.shield
```kconfig
config SHIELD_TUCK-N-ROLL_LEFT
	def_bool $(shields_list_contains,tuck-n-roll_left)

config SHIELD_TUCK-N-ROLL_RIGHT
	def_bool $(shields_list_contains,tuck-n-roll_right)
```
